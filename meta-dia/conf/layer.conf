## meta-dia/conf/layer.conf
```bitbake
# We have a conf and classes directory, add to BBPATH
BBPATH .= ":${LAYERDIR}"

# We have recipes-* directories, add to BBFILES
BBFILES += "${LAYERDIR}/recipes-*/*/*.bb \
            ${LAYERDIR}/recipes-*/*/*.bbappend"

BBFILE_COLLECTIONS += "meta-dia"
BBFILE_PATTERN_meta-dia = "^${LAYERDIR}/"
BBFILE_PRIORITY_meta-dia = "6"

LAYERDEPENDS_meta-dia = "core"
LAYERSERIES_COMPAT_meta-dia = "styhead"
```
